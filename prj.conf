## CMakeLists.txt
```
cmake_minimum_required(VERSION 3.20.0)

find_package(Zephyr REQUIRED HINTS $ENV{ZEPHYR_BASE})

project(firmware_devx)

target_sources(app PRIVATE src/main.c src/matrix.c src/render.c)
```

## prj.conf
```kconfig
CONFIG_GPIO=y
CONFIG_I2C=y
CONFIG_LED=y
```

## src/main.c
```c
/*
 * SPDX-License-Identifier: Apache-2.0
 *
 * Arduino Uno R4 WiFi — "Firmware DevX" demo.
 *
 * On each reset:
 *   1. Blinks the built-in LED (D13) in the "Shave and a Haircut, Two Bits"
 *      rhythm.
 *   2. Loops forever, scrolling FIRM / WARE / DEV downward across the 12×8
 *      LED matrix, then holds a large diagonal X for 3 s, then repeats.
 */

#include <zephyr/kernel.h>
#include <zephyr/drivers/gpio.h>
#include "matrix.h"
#include "render.h"

/* -----------------------------------------------------------------------
 * D13 LED — "Shave and a Haircut" rhythm
 * --------------------------------------------------------------------- */

#define LED0_NODE DT_ALIAS(led0)
static const struct gpio_dt_spec led = GPIO_DT_SPEC_GET(LED0_NODE, gpios);

#define KNOCK_MS 120
#define EIGHTH   250
#define QUARTER  500
#define HALF     1000

static const int gaps[] = {
	QUARTER - KNOCK_MS,        /* "Shave"  */
	EIGHTH  - KNOCK_MS,        /* "and"    */
	EIGHTH  - KNOCK_MS,        /* "a"      */
	QUARTER - KNOCK_MS,        /* "hair"   */
	QUARTER + HALF - KNOCK_MS, /* "cut" — big pause */
	QUARTER - KNOCK_MS,        /* "two"    */
	0,                         /* "bits"   */
};

static void shave_and_a_haircut(void)
{
	if (!gpio_is_ready_dt(&led)) {
		return;
	}
	gpio_pin_configure_dt(&led, GPIO_OUTPUT_INACTIVE);
	k_msleep(QUARTER);

	for (int i = 0; i < (int)ARRAY_SIZE(gaps); i++) {
		gpio_pin_set_dt(&led, 1);
		k_msleep(KNOCK_MS);
		gpio_pin_set_dt(&led, 0);
		if (gaps[i] > 0) {
			k_msleep(gaps[i]);
		}
	}
}

/* -----------------------------------------------------------------------
 * Entry point
 * --------------------------------------------------------------------- */

int main(void)
{
	/* Step 1: classic rhythm on D13. */
	shave_and_a_haircut();

	/* Step 2: initialise the IS31FL3741A LED matrix over I2C. */
	matrix_init();

	/* Step 3: scroll FIRM / WARE / DEV, then hold large X — forever. */
	while (1) {
		for (int i = 0; i < num_scroll_words; i++) {
			scroll_word(&scroll_words[i]);
		}
		display_large_x();
	}

	return 0;
}
```

## src/matrix.c
```c
/*
 * SPDX-License-Identifier: Apache-2.0
 *
 * IS31FL3741A raw-I2C driver for the Arduino Uno R4 WiFi LED matrix.
 *
 * Register model summary:
 *   Write 0xC5 → reg 0xFE  : unlock command register
 *   Write <page> → reg 0xFD: select active register page
 *   Page 0 (PWM, LEDs   0-179), Page 1 (PWM, LEDs 180-350)
 *   Page 2 (Scale, 0-179),      Page 3 (Scale, 180-350)
 *   Page 4: Function registers (config, global current, reset)
 */

#include "matrix.h"

#include <zephyr/kernel.h>
#include <zephyr/drivers/i2c.h>
#include <string.h>

#define IS31_ADDR           0x30

#define IS31_REG_UNLOCK     0xFE
#define IS31_UNLOCK_KEY     0xC5
#define IS31_REG_CMD        0xFD

#define IS31_PAGE_PWM0      0x00
#define IS31_PAGE_PWM1      0x01
#define IS31_PAGE_SCALE0    0x02
#define IS31_PAGE_SCALE1    0x03
#define IS31_PAGE_FUNC      0x04

#define IS31_FUNC_CONFIG    0x00   /* bit 0 = software enable */
#define IS31_FUNC_GCUR      0x01   /* global current control  */
#define IS31_FUNC_RESET     0x3F   /* write 0xAE to soft-reset */

static const struct device *i2c_dev;
static bool matrix_ok;

static int is31_select_page(uint8_t page)
{
	uint8_t unlock[] = { IS31_REG_UNLOCK, IS31_UNLOCK_KEY };
	int r = i2c_write(i2c_dev, unlock, sizeof(unlock), IS31_ADDR);

	if (r) {
		return r;
	}
	uint8_t cmd[] = { IS31_REG_CMD, page };

	return i2c_write(i2c_dev, cmd, sizeof(cmd), IS31_ADDR);
}

static int is31_write_reg(uint8_t reg, uint8_t val)
{
	uint8_t buf[] = { reg, val };

	return i2c_write(i2c_dev, buf, sizeof(buf), IS31_ADDR);
}

static int is31_burst_write(uint8_t start_reg,
			    const uint8_t *data, uint16_t len)
{
	struct i2c_msg msgs[2];

	msgs[0].buf   = &start_reg;
	msgs[0].len   = 1;
	msgs[0].flags = I2C_MSG_WRITE;

	msgs[1].buf   = (uint8_t *)data;
	msgs[1].len   = len;
	msgs[1].flags = I2C_MSG_WRITE | I2C_MSG_STOP;

	return i2c_transfer(i2c_dev, msgs, 2, IS31_ADDR);
}

bool matrix_init(void)
{
	i2c_dev = DEVICE_DT_GET(DT_NODELABEL(iic0));
	if (!device_is_ready(i2c_dev)) {
		return false;
	}

	/* Soft-reset. */
	is31_select_page(IS31_PAGE_FUNC);
	if (is31_write_reg(IS31_FUNC_RESET, 0xAE) != 0) {
		return false;
	}
	k_msleep(10);

	/* Global current ~25 %, enable chip. */
	is31_select_page(IS31_PAGE_FUNC);
	is31_write_reg(IS31_FUNC_GCUR, 0x20);
	is31_write_reg(IS31_FUNC_CONFIG, 0x01);

	/* Set all scaling registers to maximum. */
	uint8_t sc[180];

	memset(sc, 0xFF, sizeof(sc));

	is31_select_page(IS31_PAGE_SCALE0);
	is31_burst_write(0x00, sc, 180);

	is31_select_page(IS31_PAGE_SCALE1);
	is31_burst_write(0x00, sc, 171); /* 351 - 180 = 171 channels */

	matrix_ok = true;
	return true;
}

void matrix_clear(void)
{
	if (!matrix_ok) {
		return;
	}

	uint8_t zeros[180];

	memset(zeros, 0, sizeof(zeros));

	is31_select_page(IS31_PAGE_PWM0);
	is31_burst_write(0x00, zeros, 180);

	/* Highest used offset: row 7, col 11 → 7*39+11 = 284, reg = 104. */
	is31_select_page(IS31_PAGE_PWM1);
	is31_burst_write(0x00, zeros, 105);
}

void matrix_set(int row, int col, bool on)
{
	if (!matrix_ok) {
		return;
	}
	if (row < 0 || row >= MATRIX_ROWS || col < 0 || col >= MATRIX_COLS) {
		return;
	}

	int offset    = matrix_led_offset(row, col);
	uint8_t page  = (offset < 180) ? IS31_PAGE_PWM0 : IS31_PAGE_PWM1;
	uint8_t reg   = (uint8_t)((offset < 180) ? offset : offset - 180);

	is31_select_page(page);
	is31_write_reg(reg, on ? 0xFF : 0x00);
}
```

## src/matrix.h
```c
/*
 * SPDX-License-Identifier: Apache-2.0
 *
 * IS31FL3741A LED matrix driver interface.
 * Hardware: IS31FL3741A on the Arduino Uno R4 WiFi, reachable via iic0
 * (SCL=P4_0, SDA=P4_1, I2C address 0x30).
 */

#ifndef MATRIX_H
#define MATRIX_H

#include <stdbool.h>

#define MATRIX_ROWS 8
#define MATRIX_COLS 12

/*
 * LED offset formula: offset = (sw-1)*39 + (cs-1) = row*39 + col.
 * page 0 covers offsets 0-179, page 1 covers 180-350.
 * Exposed as an inline so tests can verify the math without I2C.
 */
static inline int matrix_led_offset(int row, int col)
{
	return row * 39 + col;
}

/*
 * Initialise the IS31FL3741A.  Must be called before matrix_clear/matrix_set.
 * Returns true on success (chip found and configured).
 */
bool matrix_init(void);

/* Fill all PWM registers with 0 (blank display). */
void matrix_clear(void);

/* Set a single LED on or off.  Out-of-range coordinates are silently ignored. */
void matrix_set(int row, int col, bool on);

#endif /* MATRIX_H */
```

## src/render.c
```c
/*
 * SPDX-License-Identifier: Apache-2.0
 *
 * Font data, word definitions, and LED-matrix rendering.
 */

#include "render.h"
#include "matrix.h"

#include <zephyr/kernel.h>
#include <stdbool.h>

#define SCROLL_FRAME_MS 80

/* 3×5 font — row order top-to-bottom, MSB = leftmost pixel. */
const uint8_t font3x5[][FONT_HEIGHT] = {
	/* F */ { 0b111, 0b100, 0b110, 0b100, 0b100 },
	/* I */ { 0b111, 0b010, 0b010, 0b010, 0b111 },
	/* R */ { 0b110, 0b101, 0b110, 0b101, 0b101 },
	/* M */ { 0b101, 0b111, 0b101, 0b101, 0b101 },
	/* W */ { 0b101, 0b101, 0b111, 0b111, 0b010 },
	/* A */ { 0b010, 0b101, 0b111, 0b101, 0b101 },
	/* E */ { 0b111, 0b100, 0b110, 0b100, 0b111 },
	/* D */ { 0b110, 0b101, 0b101, 0b101, 0b110 },
	/* V */ { 0b101, 0b101, 0b101, 0b010, 0b010 },
};

static const int chars_FIRM[] = { CHAR_F, CHAR_I, CHAR_R, CHAR_M };
static const int chars_WARE[] = { CHAR_W, CHAR_A, CHAR_R, CHAR_E };
static const int chars_DEV[]  = { CHAR_D, CHAR_E, CHAR_V };

const struct word scroll_words[] = {
	{ chars_FIRM, 4 },
	{ chars_WARE, 4 },
	{ chars_DEV,  3 },
};

const int num_scroll_words = (int)(sizeof(scroll_words) / sizeof(scroll_words[0]));

void render_word(const struct word *w, int y_top)
{
	int x_start = (MATRIX_COLS - w->len * FONT_WIDTH) / 2;

	matrix_clear();

	for (int ci = 0; ci < w->len; ci++) {
		const uint8_t *glyph = font3x5[w->chars[ci]];
		int x = x_start + ci * FONT_WIDTH;

		for (int gy = 0; gy < FONT_HEIGHT; gy++) {
			int row = y_top + gy;

			if (row < 0 || row >= MATRIX_ROWS) {
				continue;
			}
			for (int gx = 0; gx < FONT_WIDTH; gx++) {
				bool on = (glyph[gy] >> (2 - gx)) & 1;

				matrix_set(row, x + gx, on);
			}
		}
	}
}

void scroll_word(const struct word *w)
{
	for (int y = -(FONT_HEIGHT - 1); y <= MATRIX_ROWS; y++) {
		render_word(w, y);
		k_msleep(SCROLL_FRAME_MS);
	}
}

void display_large_x_frame(void)
{
	/*
	 * Diagonal X pattern for an 8×12 display.
	 * Bit N = col N (bit 0 = col 0).
	 *   Row 0: cols  0, 11  → 0x801
	 *   Row 1: cols  1, 10  → 0x402
	 *   Row 2: cols  2,  9  → 0x204
	 *   Row 3: cols 3,4,7,8 → 0x198
	 *   Row 4: cols 3,4,7,8 → 0x198
	 *   Row 5: cols  2,  9  → 0x204
	 *   Row 6: cols  1, 10  → 0x402
	 *   Row 7: cols  0, 11  → 0x801
	 */
	static const uint16_t large_x[MATRIX_ROWS] = {
		0x801, 0x402, 0x204, 0x198,
		0x198, 0x204, 0x402, 0x801,
	};

	matrix_clear();
	for (int row = 0; row < MATRIX_ROWS; row++) {
		for (int col = 0; col < MATRIX_COLS; col++) {
			matrix_set(row, col, (large_x[row] >> col) & 1);
		}
	}
}

void display_large_x(void)
{
	display_large_x_frame();
	k_msleep(3000);
}
```

## src/render.h
```c
/*
 * SPDX-License-Identifier: Apache-2.0
 *
 * Rendering layer: 3×5 font, word scrolling, and the large-X animation.
 * Depends only on matrix_clear() / matrix_set() — not on the I2C driver —
 * so render.c can be linked against a stub matrix for unit testing.
 */

#ifndef RENDER_H
#define RENDER_H

#include <stdint.h>
#include "matrix.h"

#define FONT_WIDTH  3
#define FONT_HEIGHT 5

/* Character indices into font3x5[]. */
#define CHAR_F 0
#define CHAR_I 1
#define CHAR_R 2
#define CHAR_M 3
#define CHAR_W 4
#define CHAR_A 5
#define CHAR_E 6
#define CHAR_D 7
#define CHAR_V 8

/* 3×5 pixel font; font3x5[c][row] — MSB = left pixel. */
extern const uint8_t font3x5[][FONT_HEIGHT];

struct word {
	const int *chars;
	int len;
};

extern const struct word scroll_words[];
extern const int num_scroll_words;

/*
 * Draw `w` onto the matrix with the top of its 5-row glyph at screen row
 * `y_top`.  Rows outside [0, MATRIX_ROWS) are silently clipped.
 * Calls matrix_clear() then matrix_set() as required.
 */
void render_word(const struct word *w, int y_top);

/*
 * Scroll `w` downward across the full display (enters at top, exits at
 * bottom), pausing SCROLL_FRAME_MS between frames.
 */
void scroll_word(const struct word *w);

/*
 * Draw the large diagonal X pattern — no delay.
 * Call this directly from tests to avoid the 3-second k_msleep.
 */
void display_large_x_frame(void);

/* display_large_x_frame() followed by a 3-second pause. */
void display_large_x(void);

#endif /* RENDER_H */
```
